## CMakeLists.txt
```
# SPDX-License-Identifier: Apache-2.0

cmake_minimum_required(VERSION 3.20.0)

find_package(Zephyr REQUIRED HINTS $ENV{ZEPHYR_BASE})
project(run_script_flash)

target_sources(app PRIVATE src/main.c)

add_subdirectory(${CMAKE_CURRENT_SOURCE_DIR}/../../common/lua  ${CMAKE_CURRENT_BINARY_DIR}/lua)

target_link_libraries(app PRIVATE lua)

set(gen_dir ${ZEPHYR_BINARY_DIR}/include/generated/)
generate_inc_file_for_target(
    app
    ${CMAKE_CURRENT_SOURCE_DIR}/script/main.lua
    ${gen_dir}/main.lua.inc
)
```

## prj.conf
```kconfig
# nothing here

CONFIG_NEWLIB_LIBC=y
CONFIG_NEWLIB_LIBC_NANO=n
CONFIG_NEWLIB_LIBC_FLOAT_PRINTF=y
CONFIG_NEWLIB_LIBC_FLOAT_SCANF=y
CONFIG_FILE_SYSTEM=y

CONFIG_MAIN_STACK_SIZE=4096

CONFIG_DEBUG=y

CONFIG_LOG=y
```

## src/main.c
```c
/*
 * Copyright (c) 2012-2014 Wind River Systems, Inc.
 *
 * SPDX-License-Identifier: Apache-2.0
 */

#include <zephyr/zephyr.h>
#include <zephyr/logging/log.h>

#include "lua.h"
#include "lauxlib.h"
#include "lualib.h"

LOG_MODULE_REGISTER(main);

const char lua_script_bin[] = {
#include "main.lua.inc"
};

static int lua_run_script(const char *script_str)
{
    lua_State *L;
    L = luaL_newstate();
    luaL_openlibs(L);
    luaopen_base(L);

    luaL_dostring(L, script_str);

    lua_close(L);
    return 0;
}

void main(void)
{
	lua_run_script(lua_script_bin);
}
```
